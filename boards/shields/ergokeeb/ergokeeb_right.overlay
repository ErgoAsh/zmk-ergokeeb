#include "ergokeeb.dtsi"

/*
 * ProMicro nRF52840 (nice!nano v2) pinout and usage table
 * reference: https://nicekeyboards.com/docs/nice-nano/pinout-schematic
 *
 * | left pin | nRF52 pin |   usage   |       |   usage   | nRF52 pin | right pin |
 * | :------- | :-------: | :-------: | :---: | :-------: | :-------: | :-------: |
 * | BATTERY- | -         |           |       |           | -         | BATTERY+  |
 * | D1 (TX)  | P0.06     |           |       |           | -         | RAW       |
 * | D0 (RX)  | P0.08     |           |       |           | -         | GND       |
 * | GND      | -         |           |       |           | -         | RESET     |
 * | GND      | -         |           |       |           | -         | VDD       |
 * | D2       | P0.17     |           |       |           | P0.31     | D21       |
 * | D3       | P0.20     |           |       |      C2   | P0.29     | D20       |
 * | D4       | P0.22     |  R3       |       |      C1   | P0.02     | D19       |
 * | D5       | P0.24     |  R2       |       |  R1       | P1.15     | D18       |
 * | D6       | P1.00     |      C4   |       |           | P1.13     | D15       |
 * | D7       | P0.11     |      C5   |       | LED strip | P1.11     | D14       |
 * | D8       | P1.04     |      C6   |       |           | P0.10     | D16       |
 * | D9       | P1.06     |  R4       |       |      C3   | P0.09     | D10       |
 */

&kscan0 {
    row-gpios
        = <&pro_micro 18 GPIO_ACTIVE_HIGH>
        , <&pro_micro 5 GPIO_ACTIVE_HIGH>
        , <&pro_micro 4 GPIO_ACTIVE_HIGH>                                                                                                                                                                                                                                                                                                                                                                                                                                                                                                                                                               
        , <&pro_micro 9 GPIO_ACTIVE_HIGH>
        ;

    // The column pins are listed in reverse order, starting with pin 8 instead of pin 19.
    col-gpios
        = <&pro_micro 8 (GPIO_PULL_DOWN | GPIO_ACTIVE_HIGH)>
        , <&pro_micro 7 (GPIO_PULL_DOWN | GPIO_ACTIVE_HIGH)>
        , <&pro_micro 6 (GPIO_PULL_DOWN | GPIO_ACTIVE_HIGH)>
        , <&pro_micro 10 (GPIO_PULL_DOWN | GPIO_ACTIVE_HIGH)>
        , <&pro_micro 20 (GPIO_PULL_DOWN | GPIO_ACTIVE_HIGH)>
        , <&pro_micro 19 (GPIO_PULL_DOWN | GPIO_ACTIVE_HIGH)>
        ;
};

&default_transform0 {
    // Offsets the local right matrix to continue sequentially after the left matrix.
    col-offset = <6>;
};





