#include "ergokeeb.dtsi"

&kscan0 {
    row-gpios
        = <&pro_micro 20 GPIO_ACTIVE_HIGH> // P0.29 - D20
        , <&pro_micro 19 GPIO_ACTIVE_HIGH> // P0.02 - D19
        , <&pro_micro 18 GPIO_ACTIVE_HIGH> // P1.15 - D18                                                                                                                                                                                                                                                                                                                             
        , <&pro_micro 15 GPIO_ACTIVE_HIGH> // P1.13 - D15
        ;

    col-gpios
        = <&pro_micro 7 (GPIO_PULL_DOWN | GPIO_ACTIVE_HIGH)> // P0.11 - D7
        , <&pro_micro 6 (GPIO_PULL_DOWN | GPIO_ACTIVE_HIGH)> // P1.00 - D6
        , <&pro_micro 5 (GPIO_PULL_DOWN | GPIO_ACTIVE_HIGH)> // P0.24 - D5
        , <&pro_micro 4 (GPIO_PULL_DOWN | GPIO_ACTIVE_HIGH)> // P0.22 - D4
        , <&pro_micro 3 (GPIO_PULL_DOWN | GPIO_ACTIVE_HIGH)> // P0.20 - D3
        , <&pro_micro 21 (GPIO_PULL_DOWN | GPIO_ACTIVE_HIGH)> // P0.31 - D21
        ;
};